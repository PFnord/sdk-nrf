## samples/crypto/secure_storage/boards/nrf54l15dk_nrf54l15_cpuapp.conf
```kconfig
#
# Copyright (c) 2024 Nordic Semiconductor ASA
#
# SPDX-License-Identifier: LicenseRef-Nordic-5-Clause

# Using hardware crypto accelerator
CONFIG_PSA_CRYPTO_DRIVER_OBERON=n
CONFIG_PSA_CRYPTO_DRIVER_CRACEN=y

CONFIG_PSA_WANT_ALG_JPAKE=y
CONFIG_PSA_WANT_ALG_SPAKE2P_MATTER=y
CONFIG_PSA_WANT_ALG_SRP_6=y
CONFIG_PSA_WANT_ALG_TLS12_ECJPAKE_TO_PMS=y


# When TF-M is not in use, the Secure storage subsystem provides the PSA Secure Storage API.
CONFIG_SECURE_STORAGE=y

CONFIG_FLASH=y
CONFIG_FLASH_PAGE_LAYOUT=y
CONFIG_FLASH_MAP=y
CONFIG_ZMS=y
CONFIG_SETTINGS=y

CONFIG_MBEDTLS_PSA_CRYPTO_STORAGE_C=y
CONFIG_HW_UNIQUE_KEY=y

CONFIG_SECURE_STORAGE_ITS_STORE_IMPLEMENTATION_NONE=n
CONFIG_SECURE_STORAGE_ITS_STORE_IMPLEMENTATION_SETTINGS=y
CONFIG_MBEDTLS_ENABLE_HEAP=y
CONFIG_MBEDTLS_HEAP_SIZE=8192

CONFIG_NEWLIB_LIBC_NANO=n

CONFIG_PSA_WANT_KEY_TYPE_SRP_KEY_PAIR_IMPORT=y
CONFIG_PSA_WANT_KEY_TYPE_SRP_KEY_PAIR_EXPORT=y
CONFIG_PSA_WANT_KEY_TYPE_SRP_KEY_PAIR_GENERATE=y
CONFIG_PSA_WANT_KEY_TYPE_SRP_KEY_PAIR_DERIVE=y

CONFIG_PSA_WANT_KEY_TYPE_ECC_KEY_PAIR_GENERATE=y
CONFIG_PSA_WANT_KEY_TYPE_ECC_KEY_PAIR_IMPORT=y
CONFIG_PSA_WANT_KEY_TYPE_ECC_KEY_PAIR_EXPORT=y
CONFIG_PSA_WANT_KEY_TYPE_ECC_KEY_PAIR_DERIVE=y

# Ciphers
CONFIG_PSA_WANT_ALG_ECB_NO_PADDING=y
CONFIG_PSA_WANT_ALG_CBC_NO_PADDING=y
CONFIG_PSA_WANT_ALG_CBC_PKCS7=y
CONFIG_PSA_WANT_ALG_CTR=y

CONFIG_PSA_WANT_ALG_STREAM_CIPHER=y

# MAC
CONFIG_PSA_WANT_ALG_CMAC=y
CONFIG_PSA_WANT_ALG_HMAC=y

# AEAD
CONFIG_PSA_WANT_ALG_CCM=y
CONFIG_PSA_WANT_ALG_CCM_STAR_NO_TAG=y
CONFIG_PSA_WANT_ALG_GCM=y
CONFIG_PSA_WANT_ALG_CHACHA20_POLY1305=y

# AES key sizes
CONFIG_PSA_WANT_AES_KEY_SIZE_128=y

# RSA key sizes
CONFIG_PSA_WANT_RSA_KEY_SIZE_2048=y
CONFIG_PSA_WANT_RSA_KEY_SIZE_3072=y
CONFIG_PSA_WANT_RSA_KEY_SIZE_4096=y

# ECC
CONFIG_PSA_WANT_ALG_ECDH=y
CONFIG_PSA_WANT_ALG_ECDSA=y
CONFIG_PSA_WANT_ALG_PURE_EDDSA=y
CONFIG_PSA_WANT_ALG_DETERMINISTIC_ECDSA=y

# ECC curves
CONFIG_PSA_WANT_ECC_MONTGOMERY_255=y
CONFIG_PSA_WANT_ECC_TWISTED_EDWARDS_255=y
CONFIG_PSA_WANT_ECC_TWISTED_EDWARDS_448=y
CONFIG_PSA_WANT_ECC_SECP_R1_224=y
CONFIG_PSA_WANT_ECC_SECP_R1_256=y
CONFIG_PSA_WANT_ECC_SECP_R1_384=y

CONFIG_PSA_WANT_ALG_SHA_256=y

CONFIG_SETTINGS_LOG_LEVEL_DBG=y
CONFIG_ZMS_LOG_LEVEL_DBG=y

CONFIG_SECURE_STORAGE_LOG_LEVEL_DBG=y
```

## samples/keys/identity_key_generation/sample.yaml
```yaml
sample:
  description: Generate and write identity key.
  name: Identity key generation sample
common:
  tags:
    - keys
    - ci_samples_keys
  platform_allow:
    - nrf5340dk/nrf5340/cpuapp
    - nrf9160dk/nrf9160
    - nrf9161dk/nrf9161
    - nrf9151dk/nrf9151
    - nrf54l15dk/nrf54l15/cpuapp
    - nrf54lm20dk/nrf54lm20b/cpuapp
    - nrf54lm20dk/nrf54lm20a/cpuapp
    - nrf54lv10dk/nrf54lv10a/cpuapp
  integration_platforms:
    - nrf5340dk/nrf5340/cpuapp
    - nrf9160dk/nrf9160
    - nrf9161dk/nrf9161
    - nrf9151dk/nrf9151
    - nrf54l15dk/nrf54l15/cpuapp
    - nrf54lm20dk/nrf54lm20b/cpuapp
    - nrf54lm20dk/nrf54lm20a/cpuapp
    - nrf54lv10dk/nrf54lv10a/cpuapp
  harness: console
  harness_config:
    type: multi_line
    regex:
      - "Writing the identity key to KMU"
      - "Success!"
tests:
  sample.keys.identity_key_generate.random_key:
    sysbuild: true
    tags:
      - keys
      - ci_build
      - sysbuild
      - ci_samples_keys
  # The TFM regression tests rely on a specific key in order to pass.
  # This sample configuration is mainly useful for writing that expected key,
  # which is called a "dummy key".
  sample.keys.identity_key_generate.static_key:
    sysbuild: true
    extra_configs:
      - CONFIG_IDENTITY_KEY_DUMMY=y
    tags:
      - keys
      - ci_build
      - sysbuild
      - ci_samples_keys
```

## samples/keys/identity_key_usage/sample.yaml
```yaml
sample:
  description: Use a previously written identity key from KMU.
  name: Identity Key Usage
common:
  tags:
    - keys
    - ci_samples_keys
  platform_allow:
    - nrf5340dk/nrf5340/cpuapp
    - nrf9160dk/nrf9160
    - nrf9161dk/nrf9161
    - nrf9151dk/nrf9151
    - nrf54l15dk/nrf54l15/cpuapp
    - nrf54lm20dk/nrf54lm20b/cpuapp
    - nrf54lm20dk/nrf54lm20a/cpuapp
    - nrf54lv10dk/nrf54lv10a/cpuapp
  integration_platforms:
    - nrf5340dk/nrf5340/cpuapp
    - nrf9160dk/nrf9160
    - nrf9161dk/nrf9161
    - nrf9151dk/nrf9151
    - nrf54l15dk/nrf54l15/cpuapp
    - nrf54lm20dk/nrf54lm20b/cpuapp
    - nrf54lm20dk/nrf54lm20a/cpuapp
    - nrf54lv10dk/nrf54lv10a/cpuapp
  harness: console
  harness_config:
    type: multi_line
    regex:
      - "Ciphertext \\(with authentication tag\\):"
tests:
  sample.keys.identity_key_usage:
    sysbuild: true
    tags:
      - keys
      - ci_build
      - sysbuild
      - ci_samples_keys
    build_only: true
```
